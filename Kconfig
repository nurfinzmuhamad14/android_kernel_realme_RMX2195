## Kconfig
```kconfig
# SPDX-License-Identifier: GPL-2.0
#
# For a description of the syntax of this configuration file,
# see Documentation/kbuild/kconfig-language.txt.
#
mainmenu "Linux/$(ARCH) $(KERNELVERSION) Kernel Configuration"

comment "Compiler: $(CC_VERSION_TEXT)"

#ifdef VENDOR_EDIT
#Wen.Luo@Bsp.Kernel.Stability,2020/4/20,OPLUS_SYSTEM_KERNEL_QCOM/OPLUS_SYSTEM_KERNEL_MTK add for qcom/mtk platform
config OPLUS_SYSTEM_KERNEL_QCOM
  bool "config oplus system feature "
  default y
  help
	define this config to Distinguish between qcom and mtk platform
#endif

#ifdef VENDOR_EDIT
#Wen.Luo@Bsp.Kernel.Stability, 2018/12/05, Add for aging test, slub debug config
config OPPO_SLUB_TEST
	string
	default "$(OPPO_SLUB_TEST)"

config OPPO_KASAN_TEST
	string
	default "$(OPPO_KASAN_TEST)"

config OPPO_KMEMLEAK_TEST
	string
	default "$(OPPO_KMEMLEAK_TEST)"

config OPPO_AGING_TEST
	string
	default "$(OPPO_AGING_TEST)"

config OPPO_PAGEOWNER_TEST
	string
	default "$(OPPO_PAGEOWNER_TEST)"

config OPPO_AGING_DEBUG
	bool "oplus aging add config"
	select IPC_LOGGING
	select QCOM_RTB
	select QCOM_RTB_SEPARATE_CPUS
	select SCSI_LOGGING
	select SCSI_UFSHCD_CMD_LOGGING
	select KPROBES
	default y if OPPO_AGING_TEST = "true"
	default n

config OPPO_KASAN_DEBUG
	bool "oplus kasan debug"
	select KASAN
	select KASAN_GENERIC
	select KCOV
	select KCOV_ENABLE_COMPARISONS
	default y if OPPO_KASAN_TEST = "true"
	default n

config OPPO_KMEMLEAK_DEBUG
	bool "oplus kmemleak debug"
	select DEBUG_KMEMLEAK
	select SLUB_DEBUG
	select SLABTRACE_DEBUG
	default y if OPPO_KMEMLEAK_TEST = "true"
	default n

config OPPO_SLUB_DEBUG
	bool "oplus slub debug"
	select SLUB_DEBUG
	select SLUB_DEBUG_ON
	select SLUB_DEBUG_PANIC_ON
	default y if OPPO_SLUB_TEST = "true"
	default n

config OPPO_PAGEOWNER_DEBUG
	bool "oplus pageowner debug"
	select PAGE_OWNER
	select PAGE_OWNER_ENABLE_DEFAULT
	default y if OPPO_PAGEOWNER_TEST = "true"
	default n
#endif /*VENDOR_EDIT*/

source "scripts/Kconfig.include"

source "init/Kconfig"

source "kernel/Kconfig.freezer"

source "fs/Kconfig.binfmt"

source "mm/Kconfig"

source "net/Kconfig"

source "drivers/Kconfig"

source "fs/Kconfig"

source "security/Kconfig"

source "crypto/Kconfig"

source "lib/Kconfig"

source "lib/Kconfig.debug"

comment "Qualcomm Atheros CLD WLAN module"

config QCA_CLD_WLAN

	tristate "Qualcomm Atheros CLD WLAN module"
	default n
	help
	Add support for the Qualcomm Atheros CLD WLAN module

if QCA_CLD_WLAN != n

config QCACLD_WLAN_LFR3
	bool "Enable the WLAN Legacy Fast Roaming feature Version 3"
	default n

config PRIMA_WLAN_OKC
	bool "Enable the Prima WLAN Opportunistic Key Caching feature"
	default n

config WLAN_FEATURE_11W
	bool "Enable the WLAN 802.11w Protected Management Frames feature"
	default n

config WLAN_FEATURE_LPSS
	bool "Enable the WLAN LPSS feature"
	default n

config QCOM_VOWIFI_11R
	bool "Enable Fast Transition (11r) feature"
	default n

config QCACLD_FEATURE_NAN
	bool "Enable NAN feature"
	default n

config WLAN_FEATURE_NAN_DATAPATH
	bool "Enable NaN Data Path feature"
	depends on QCACLD_FEATURE_NAN
	default n

config QCACLD_FEATURE_GREEN_AP
	bool "Enable Green AP feature"
	default n

config HELIUMPLUS
	bool "Enable Beeliner based descriptor structures for Helium"
	default n

config 64BIT_PADDR
	bool "Enable 37-bit physical/bus addresses"
	depends on HELIUMPLUS
	default n

config QCOM_TDLS
	bool "Enable TDLS feature"
	default n

config QCOM_LTE_COEX
	bool "Enable QCOM LTE Coex feature"
	default n

config MPC_UT_FRAMEWORK
	bool "Enable Unit test framework for multiport concurrency"
	default n

config WLAN_OFFLOAD_PACKETS
	bool "Enable offload packets feature"
	default n

config FEATURE_TSO
	bool "Enable TCP Segmentation Offload"
	depends on HELIUMPLUS
	default n

config FEATURE_TSO_DEBUG
	bool "Enable TCP Segmentation Offload with debug"
	depends on FEATURE_TSO
	default n

config WLAN_FASTPATH
	bool "Enable fastpath for datapackets"
	default n

config WLAN_NAPI
	bool "Enable NAPI - datapath rx"
	default n

config WLAN_NAPI_DEBUG
       bool "Enable debug logging on NAPI"
       depends on WLAN_NAPI
       default n

config WLAN_TX_FLOW_CONTROL_V2
	bool "Enable tx flow control version:2"
	default n

config WLAN_LRO
	bool "Enable Large Receive Offload"
	depends on HELIUMPLUS
	depends on INET_LRO
	default n

config WLAN_SYNC_TSF
	bool "Enable QCOM sync multi devices tsf feature"
	default n

config LFR_SUBNET_DETECTION
	bool "Enable LFR Subnet Change Detection"
	default n

config MCC_TO_SCC_SWITCH
	bool "Enable MCC to SCC Switch Logic"
	default n

config QCACLD_WLAN_LFR2
	bool "Enable the WLAN Legacy Fast Roaming feature Version 2"
	default n

config WLAN_FEATURE_DISA
	bool "Enable DISA certification feature"
	default n

config WLAN_FEATURE_FIPS
	bool "Enable FIPS certification feature"
	default n

config WLAN_FEATURE_11AX
	bool "Enable 11AX(High Efficiency) feature"
	default n

config ICMP_DISABLE_PS
	bool "Enable ICMP packet disable powersave feature"
	default n

config BUILD_TIMESTAMP
	bool "Embed timestamp in wlan version"
	default n

config WLAN_FEATURE_FILS
	bool "Enable FILS feature"
	default n

config NAN_CONVERGENCE
	bool "Enable NAN_CONVERGENCE feature"
	default n

config WLAN_OBJMGR_DEBUG
	bool "Enable WLAN Obj Mgr Debug services"
	default n

config WLAN_FEATURE_DFS_OFFLOAD
	bool "Enable dfs offload feature"
	default n

config WLAN_FEATURE_SARV1_TO_SARV2
	bool "Enable conversion of SAR v1 to v2 feature"
	default n

endif # QCA_CLD_WLAN
```
